// This file was generated by running matrix_clock/tools/distance_generator.py
// with no arguments and redirecting the output to a file.

#define NUM_DISTANCES 14  // MAX is -1 this val

// Each number below is the weight to apply to a color at a given 
// distance.  The range is 0x00-0xFF.

uint8_t distance_weights[NUM_DISTANCES] __in_flash() = {
    0xFF,  // 0
    0xCB,  // 1
    0x65,  // 2
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    0x10,  // 13
};


// Each number below is the offset into the array for the given 
// distance.  The next element is used to calculate the length.
// The final element is used only for the length calculation

uint16_t distance_offsets[NUM_DISTANCES + 1] __in_flash() = {
    0x0000,  // 0
    0x0001,  // 1
    0x0004,  // 2
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    0x00C4,
};

// each element is of the format 0xXXYY
uint16_t distance_points[196] __in_flash() = {
    // 0
    0x0000,
    // 1
    0x0100, 0x0101, 0x0001,
    // 2
    0x0200, 0x0201, 0x0101, 0x0102, 0x0002,
    // 3
    0x0300, 0x0301, 0x0302, 0x0202, 0x0203, 0x0103, 0x0003,
    // 4
    0x0400, 0x0401, 0x0402, 0x0302, 0x0303, 0x0203, 0x0204, 0x0104,
    0x0004,
    // 5
    0x0500, 0x0501, 0x0502, 0x0402, 0x0403, 0x0404, 0x0304, 0x0204,
    0x0205, 0x0105, 0x0005,
    // 6
    0x0600, 0x0601, 0x0602, 0x0502, 0x0503, 0x0504, 0x0404, 0x0405,
    0x0305, 0x0205, 0x0206, 0x0106, 0x0006,
    // 7
    0x0700, 0x0701, 0x0702, 0x0703, 0x0603, 0x0604, 0x0504, 0x0505,
    0x0405, 0x0406, 0x0306, 0x0307, 0x0207, 0x0107, 0x0007,
    // 8
    0x0800, 0x0801, 0x0802, 0x0803, 0x0703, 0x0704, 0x0705, 0x0605,
    0x0606, 0x0506, 0x0507, 0x0407, 0x0307, 0x0308, 0x0208, 0x0108,
    0x0008,
    // 9
    0x0900, 0x0901, 0x0902, 0x0903, 0x0803, 0x0804, 0x0805, 0x0705,
    0x0706, 0x0606, 0x0607, 0x0507, 0x0508, 0x0408, 0x0308, 0x0309,
    0x0209, 0x0109, 0x0009,
    // 10
    0x0A00, 0x0A01, 0x0A02, 0x0A03, 0x0903, 0x0904, 0x0905, 0x0805,
    0x0806, 0x0807, 0x0707, 0x0708, 0x0608, 0x0508, 0x0509, 0x0409,
    0x0309, 0x030A, 0x020A, 0x010A, 0x000A,
    // 11
    0x0B00, 0x0B01, 0x0B02, 0x0B03, 0x0A03, 0x0A04, 0x0A05, 0x0A06,
    0x0906, 0x0907, 0x0807, 0x0808, 0x0708, 0x0709, 0x0609, 0x060A,
    0x050A, 0x040A, 0x030A, 0x030B, 0x020B, 0x010B, 0x000B,
    // 12
    0x0C00, 0x0C01, 0x0C02, 0x0C03, 0x0B03, 0x0B04, 0x0B05, 0x0B06,
    0x0A06, 0x0A07, 0x0907, 0x0908, 0x0808, 0x0809, 0x0709, 0x070A,
    0x060A, 0x060B, 0x050B, 0x040B, 0x030B, 0x030C, 0x020C, 0x010C,
    0x000C,
    // 13
    0x0D00, 0x0D01, 0x0D02, 0x0D03, 0x0D04, 0x0C04, 0x0C05, 0x0C06,
    0x0B06, 0x0B07, 0x0B08, 0x0A08, 0x0A09, 0x0909, 0x090A, 0x080A,
    0x080B, 0x070B, 0x060B, 0x060C, 0x050C, 0x040C, 0x040D, 0x030D,
    0x020D, 0x010D, 0x000D,
};

